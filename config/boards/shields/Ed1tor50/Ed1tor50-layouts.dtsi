#include <physical_layouts.dtsi>

/ {
    physical_layout0: physical_layout_0 {
        compatible = "zmk,physical-layout";
        display-name = "LAYOUT";

        kscan = <&kscan0>;
        transform = <&matrix_transform0>;

        keys  //                     w   h    x    y     rot    rx    ry
            = <&key_physical_attrs 100 100 1123  301       0     0     0>
            , <&key_physical_attrs 100 100 1291  301       0     0     0>
            ;
    };

    keypad_position_map {
    // Other properties

        compatible = "zmk,physical-layout-position-map";

        physical_layout0 {
            physical-layout = <&physical_layout0>;
            positions // This is equivalent to `positions = <0 1 2 3>;`, reshaped for readability
                = <  0  1  >;
        };
    };
};
