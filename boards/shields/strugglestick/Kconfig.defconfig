## boards/shields/strugglestick/Kconfig.defconfig
```kconfig
# Copyright (c) 2020 The ZMK Contributors
# SPDX-License-Identifier: MIT

if SHIELD_STRUGGLESTICK

config ZMK_KEYBOARD_NAME
    default "StruggleStick"

config ZMK_POINTING
    default y

config ADC
    default y

config ADC_ASYNC
    default y

config ANALOG_INPUT
    default y

config ANALOG_INPUT_LOG_DBG_RAW
    default y

config ANALOG_INPUT_LOG_DBG_REPORT
    default y

# config CONFIG_ADC
#     default y

# config CONFIG_ADC_ASYNC
#     default y

# config CONFIG_ANALOG_INPUT
#     default y

# config CONFIG_ANALOG_INPUT_LOG_DBG_RAW
#     default y

# config CONFIG_ANALOG_INPUT_LOG_DBG_REPORT
#     default y

endif
```

## config/boards/shields/Ed1tor50/Kconfig.defconfig
```kconfig
# Copyright (c) 2020 The ZMK Contributors
# SPDX-License-Identifier: MIT

if SHIELD_Ed1tor50

config ZMK_KEYBOARD_NAME
    default "Ed1tor50"
    
endif
```

## config/boards/shields/Ed1tor50/Kconfig.shield
```kconfig
# Copyright (c) 2020 The ZMK Contributors
# SPDX-License-Identifier: MIT

config SHIELD_Ed1tor50
    def_bool $(shields_list_contains,Ed1tor50)
```

## config/boards/shields/strugglestick/Kconfig.defconfig
```kconfig
# Copyright (c) 2020 The ZMK Contributors
# SPDX-License-Identifier: MIT

if SHIELD_STRUGGLESTICK

config ZMK_KEYBOARD_NAME
    default "StruggleStick"
    
endif
```

## config/boards/shields/strugglestick/Kconfig.shield
```kconfig
# Copyright (c) 2020 The ZMK Contributors
# SPDX-License-Identifier: MIT

config SHIELD_STRUGGLESTICK
    def_bool $(shields_list_contains,strugglestick)
```

## config/west.yml
```yaml
manifest:
  remotes:
    - name: jjggzhou
      url-base: https://github.com/jjggzhou
    - name: jjggzhou
      url-base: https://github.com/jjggzhou
    - name: urob
      url-base: https://github.com/urob
    - name: cormoran
      url-base: https://github.com/cormoran
    - name: zmk
      remote: jjggzhou
      revision: main
      import: app/west.yml
    - name: zmk-analog-input-driver
      remote: jjggzhou
      revision: main
    - name: zmk-auto-layer
      remote: urob
      revision: main
    - name: zmk-tri-state
      remote: urob
      revision: main
    - name: zmk-driver-animation
      remote: cormoran
      revision: main
    - name: zmk-driver-ext-power-transient
      remote: cormoran
      revision: main
  self:
    path: config





# manifest:
#   remotes:
#     - name: zmkfirmware
#       url-base: https://github.com/zmkfirmware
#     - name: badjeff
#       url-base: https://github.com/badjeff/
#     - name: yourgithub
#       url-base: https://github.com/yourgithub/
#   projects:
#     - name: zmk
#       remote: zmkfirmware
#       revision: main
#       import: app/west.yml
#     - name: zmk-analog-input-driver
#       remote: badjeff
#       revision: main
#     - name: zephyr
#       remote: yourgithub
#       revision: main
#   self:
#     path: config
```
