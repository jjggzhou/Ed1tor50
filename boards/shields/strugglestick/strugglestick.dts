/dts-v1/;
#include <nordic/nrf52840_qiaa.dtsi>
#include "seeeduino_xiao_ble-pinctrl.dtsi"
#include "seeed_xiao_connector.dtsi"


/ {
	xiao_d: connector {
		compatible = "seeed,xiao-gpio";
		#gpio-cells = <2>;
		gpio-map-mask = <0xffffffff 0xffffffc0>;
		gpio-map-pass-thru = <0 0x3f>;
		gpio-map
			= <0 0 &gpio0 2 0>		/* D0 */
			, <1 0 &gpio0 3 0>		/* D1 */
			, <2 0 &gpio0 28 0>		/* D2 */
			, <3 0 &gpio0 29 0>		/* D3 */
			, <4 0 &gpio0 4 0>		/* D4 */
			, <5 0 &gpio0 5 0>		/* D5 */
			, <6 0 &gpio1 11 0>		/* D6 */
			, <7 0 &gpio1 12 0>		/* D7 */
			, <8 0 &gpio1 13 0>		/* D8 */
			, <9 0 &gpio1 14 0>		/* D9 */
			, <10 0 &gpio1 15 0>		/* D10 */
            , <11 0 &gpio0 15 0>		/* D11 */
            , <12 0 &gpio0 19 0>		/* D12 */
            , <13 0 &gpio1 1 0>		/* D13 */
            , <14 0 &gpio0 9 0>		/* D14 */
            , <15 0 &gpio0 10 0>		/* D15 */
            , <16 0 &gpio01 31 0>		/* D16 */
            , <17 0 &gpio1 3 0>		/* D17 */
            , <18 0 &gpio1 5 0>		/* D18 */
            , <19 0 &gpio1 9 0>		/* D19 */
			;
	};
};